## Documentation/devicetree/bindings/display/msm/gpu.yaml
```yaml
# SPDX-License-Identifier: (GPL-2.0-only OR BSD-2-Clause)
%YAML 1.2
---

$id: http://devicetree.org/schemas/display/msm/gpu.yaml#
$schema: http://devicetree.org/meta-schemas/core.yaml#

title: Adreno or Snapdragon GPUs

maintainers:
  - Rob Clark <robdclark@gmail.com>

properties:
  compatible:
    oneOf:
      - description: |
          The driver is parsing the compat string for Imageon to
          figure out the gpu-id and patch level.
        items:
          - pattern: '^amd,imageon-200\.[0-1]$'
          - const: amd,imageon

  clocks: true

  clock-names: true

  reg:
    minItems: 1
    maxItems: 3

  reg-names:
    minItems: 1
    maxItems: 3

  interrupts:
    maxItems: 1

  interrupt-names:
    maxItems: 1

  power-domains:
    maxItems: 1

  "#cooling-cells":
    const: 2


required:
  - compatible
  - reg
  - interrupts

additionalProperties: false
```

## Documentation/devicetree/bindings/display/msm/qcom,adreno-200.yaml
```yaml
# SPDX-License-Identifier: (GPL-2.0-only OR BSD-2-Clause)
%YAML 1.2
---

$id: http://devicetree.org/schemas/display/msm/qcom,adreno-200.yaml#
$schema: http://devicetree.org/meta-schemas/core.yaml#

title: Adreno/Imageon 200 GPU

maintainers:
  - Rob Clark <robdclark@gmail.com>
  
description:
  Adreno/Imageon 200 GPU

properties:
  compatible:
    items:
      - pattern: '^amd,imageon-200\.[0-1]$'
      - const: amd,imageon

  clocks:
    items: 
      - description: GPU Core clock
      - description: GPU Memory Interface clock

  clock-names:
    items:
      - const: core_clk
      - const: mem_iface_clk

  reg:
    items:
      - description: base address of GPU device

  reg-names:
    items:
      - const: kgsl_3d0_reg_memory

  interrupts:
    items:
      - description: interrupt of GPU device

  interrupt-names:
    items:
      - const: kgsl_3d0_irq

required:
  - compatible
  - reg
  - interrupts

additionalProperties: false

examples:
  - |

    #include <dt-bindings/clock/imx5-clock.h>
    #include <dt-bindings/interrupt-controller/irq.h>

    gpu: gpu@30000000 {
        compatible = "amd,imageon-200.0", "amd,imageon";

        reg = <0x30000000 0x20000>;
        reg-names = "kgsl_3d0_reg_memory";

        clock-names = "core_clk", "mem_iface_clk";
        clocks = <&clks IMX5_CLK_GPU3D_GATE>,
                 <&clks IMX5_CLK_GARB_GATE>;

        interrupts = <12>;
        interrupt-names = "kgsl_3d0_irq";
    };
```

## Documentation/devicetree/bindings/display/msm/qcom,adreno-306.yaml
```yaml
# SPDX-License-Identifier: GPL-2.0-only OR BSD-2-Clause
%YAML 1.2
---
$id: http://devicetree.org/schemas/display/msm/qcom,adreno-306.yaml#
$schema: http://devicetree.org/meta-schemas/core.yaml#

title: Qualcomm Adreno 3xx GPU

maintainers:
  - Rob Clark <robdclark@gmail.com>

description:
  Device tree bindings for Adreno 306 GPU.

select:
  properties:
    compatible:
      contains:
        enum: 
          - qcom,adreno-306.0
  required:
    - compatible
 
$ref: /schemas/display/msm/qcom,adreno-common.yaml#

properties:
  compatible:
    items:
      - enum:
          - qcom,adreno-306.0
      - const: qcom,adreno
  reg:
    items:
      - description: base address of GPU device

  reg-names:
    items:
      - const: kgsl_3d0_reg_memory

  clocks:
    items:
      - description: GPU Core clock
      - description: GPU Interface clock
      - description: GPU Memory clock
      - description: GPU Memory Interface clock
      - description: GPU Memory Interface clock
      - description: GPU 3D engine clock

  clock-names:
    items:
      - const: core
      - const: iface
      - const: mem
      - const: mem_iface
      - const: alt_mem_iface
      - const: gfx3d

required:
  - clocks
  - clock-names

unevaluatedProperties: false
```

## Documentation/devicetree/bindings/display/msm/qcom,adreno-330.yaml
```yaml
# SPDX-License-Identifier: GPL-2.0-only OR BSD-2-Clause
%YAML 1.2
---
$id: http://devicetree.org/schemas/display/msm/qcom,adreno-330.yaml#
$schema: http://devicetree.org/meta-schemas/core.yaml#

title: Qualcomm Adreno 3xx GPU

maintainers:
  - Rob Clark <robdclark@gmail.com>

description:
  Device tree bindings for Adreno 330 GPU.

select:
  properties:
    compatible:
      contains:
        enum:
          - qcom,adreno-305.18
          - qcom,adreno-330.1
  required:
    - compatible


properties:
  $nodename:
    pattern: "^gpu@[0-9a-f]+$"

  compatible:
    items:
      - enum:
          - qcom,adreno-305.18
          - qcom,adreno-330.1
      - const: qcom,adreno
  reg:
    items:
      - description: base address of GPU device

  reg-names:
    items:
      - const: kgsl_3d0_reg_memory

  clocks:
    items:
      - description: GPU Core clock
      - description: GPU Interface clock
      - description: GPU Memory Interface clock

  clock-names:
    items:
      - const: core
      - const: iface
      - const: mem_iface

  interconnects:
    minItems: 1
    maxItems: 2

  interconnect-names:
    minItems: 1
    items:
      - const: gfx-mem
      - const: ocmem

  interrupts:
    maxItems: 1

  interrupt-names:
    maxItems: 1
  
  iommus:
    items:
      - description: Phandle to gpu smmu

  sram:
    $ref: /schemas/types.yaml#/definitions/phandle-array
    minItems: 1
    maxItems: 4
    items:
      maxItems: 1
    description: |
      phandles to one or more reserved on-chip SRAM regions.
      phandle to the On Chip Memory (OCMEM) that's present on some a3xx and
      a4xx Snapdragon SoCs. See
      Documentation/devicetree/bindings/sram/qcom,ocmem.yaml

  power-domains:
    maxItems: 1

  operating-points-v2: true
  opp-table:
    type: object

  "#cooling-cells":
    const: 2

required:
  - reg
  - reg-names
  - clocks
  - clock-names
  - interrupts
  - interrupt-names
  - iommus
  - power-domains

unevaluatedProperties: false

examples:
  - |
    // Example a330 :

    #include <dt-bindings/clock/qcom,gcc-msm8974.h>
    #include <dt-bindings/clock/qcom,mmcc-msm8974.h>
    #include <dt-bindings/power/qcom-rpmpd.h>
    #include <dt-bindings/interrupt-controller/irq.h>
    #include <dt-bindings/interrupt-controller/arm-gic.h>

    gpu@fdb00000 {
        compatible = "qcom,adreno-330.1", "qcom,adreno";

        reg = <0xfdb00000 0x10000>;
        reg-names = "kgsl_3d0_reg_memory";

        interrupts = <GIC_SPI 33 IRQ_TYPE_LEVEL_HIGH>;
        interrupt-names = "kgsl_3d0_irq";

        clocks = <&mmcc OXILI_GFX3D_CLK>,
                 <&mmcc OXILICX_AHB_CLK>,
                 <&mmcc OXILICX_AXI_CLK>;

        clock-names = "core",
                      "iface",
                      "mem_iface";

        power-domains = <&mmcc OXILICX_GDSC>;
        iommus = <&gpu_iommu 0>;

        sram = <&gmu_sram>;
        operating-points-v2 = <&gpu_opp_table>;

        #cooling-cells = <2>;

        gpu_opp_table: opp-table {
            compatible = "operating-points-v2";

            opp-27000000 {
                opp-hz = /bits/ 64 <27000000>;
            };

            opp-200000000  {
                opp-hz = /bits/ 64 <200000000>;
            };

            opp-320000000  {
                opp-hz = /bits/ 64 <320000000>;
            };
        };
    };
```

## Documentation/devicetree/bindings/display/msm/qcom,adreno-405.yaml
```yaml
# SPDX-License-Identifier: GPL-2.0-only OR BSD-2-Clause
%YAML 1.2
---
$id: http://devicetree.org/schemas/display/msm/qcom,adreno-405.yaml#
$schema: http://devicetree.org/meta-schemas/core.yaml#

title: Qualcomm Adreno 4xx GPU

maintainers:
  - Rob Clark <robdclark@gmail.com>

description:
  Device tree bindings for Adreno 405 GPU.

select:
  properties:
    compatible:
      contains:
        enum:
          - qcom,adreno-405.0
  required:
    - compatible

properties:
  $nodename:
    pattern: "^gpu@[0-9a-f]+$"

  compatible:
    items:
      - enum:
          - qcom,adreno-405.0
      - const: qcom,adreno
  reg:
    items:
      - description: base address of GPU device

  reg-names:
    items:
      - const: kgsl_3d0_reg_memory

  clocks:
    items:
      - description: GPU Core clock
      - description: GPU Interface clock
      - description: GPU Memory clock
      - description: GPU Memory Interface clock
      - description: GPU Memory Interface clock
      - description: GPU 3D engine clock
      - description: GPU RBBM Timer for Adreno 4xx series

  clock-names:
    items:
      - const: core
      - const: iface
      - const: mem
      - const: mem_iface
      - const: alt_mem_iface
      - const: gfx3d
      - const: rbbmtimer

  interconnects:
    minItems: 1
    maxItems: 2

  interconnect-names:
    minItems: 1
    maxItems: 2

  interrupts:
    maxItems: 1
  
  iommus:
    items:
      - description: Phandle to not secure user context-bank
      - description: Phandle to not secure priv context-bank

  power-domains:
    maxItems: 1

  operating-points-v2: true
  opp-table:
    type: object

  "#cooling-cells":
    const: 2

  nvmem-cell-names:
    maxItems: 1

  nvmem-cells:
    description: efuse registers
    maxItems: 1

required:
  - reg
  - reg-names
  - clocks
  - clock-names
  - interrupts
  - iommus
  - power-domains

unevaluatedProperties: false

examples:
  - |
    // Example a405 :

    #include <dt-bindings/clock/qcom,gcc-msm8939.h>
    #include <dt-bindings/power/qcom-rpmpd.h>
    #include <dt-bindings/interrupt-controller/irq.h>
    #include <dt-bindings/interrupt-controller/arm-gic.h>

    gpu@1c00000 {
        compatible = "qcom,adreno-405.0", "qcom,adreno";

        reg = <0x01c00000 0x40000>;
        reg-names = "kgsl_3d0_reg_memory";

        interrupts = <GIC_SPI 33 IRQ_TYPE_LEVEL_HIGH>;

        clocks = <&gcc GCC_OXILI_GFX3D_CLK>,
                 <&gcc GCC_OXILI_AHB_CLK>,
                 <&gcc GCC_OXILI_GMEM_CLK>,
                 <&gcc GCC_BIMC_GFX_CLK>,
                 <&gcc GCC_BIMC_GPU_CLK>,
                 <&gcc GFX3D_CLK_SRC>,
                 <&gcc GCC_OXILI_TIMER_CLK>;

        clock-names = "core",
                      "iface",
                      "mem",
                      "mem_iface",
                      "alt_mem_iface",
                      "gfx3d",
                      "rbbmtimer";

        power-domains = <&gcc OXILI_GDSC>;
        iommus = <&gpu_iommu 1>, <&gpu_iommu 2>;

        operating-points-v2 = <&gpu_opp_table>;

        #cooling-cells = <2>;

        gpu_opp_table: opp-table {
            compatible = "operating-points-v2";

            opp-19200000 {
                opp-hz = /bits/ 64 <19200000>;
            };

            opp-220000000 {
                opp-hz = /bits/ 64 <220000000>;
            };

            opp-400000000 {
                opp-hz = /bits/ 64 <400000000>;
            };

            opp-465000000  {
                opp-hz = /bits/ 64 <465000000>;
            };

            opp-550000000 {
                opp-hz = /bits/ 64 <550000000>;
            };

            opp-600000000 {
                opp-hz = /bits/ 64 <600000000>;
            };
        };
    };
```
