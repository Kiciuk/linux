## Documentation/devicetree/bindings/display/msm/qcom,adreno-506.yaml
```yaml
# SPDX-License-Identifier: GPL-2.0-only OR BSD-2-Clause
%YAML 1.2
---
$id: http://devicetree.org/schemas/display/msm/qcom,adreno-506.yaml#
$schema: http://devicetree.org/meta-schemas/core.yaml#

title: Qualcomm Adreno 506 GPU

maintainers:
  - Rob Clark <robdclark@gmail.com>

description:
  Device tree bindings for Adreno 506 GPU.

select:
  properties:
    compatible:
      contains:
        enum:
          - qcom,adreno-504.0
          - qcom,adreno-505.0
          - qcom,adreno-506.0
          - qcom,adreno-510.0
  required:
    - compatible

properties:
  $nodename:
    pattern: "^gpu@[0-9a-f]+$"

  compatible:
    items:
      - enum:
          - qcom,adreno-504.0
          - qcom,adreno-505.0
          - qcom,adreno-506.0
          - qcom,adreno-510.0
      - const: qcom,adreno

  reg:
    items:
      - description: base address of GPU device

  reg-names:
    items:
      - const: kgsl_3d0_reg_memory

  clocks:
    items:
      - description: GPU Always-On clock
      - description: GPU Core clock
      - description: GPU Interface clock
      - description: GPU Memory clock
      - description: GPU Memory Interface clock
      - description: GPU RBBM Timer for Adreno 5xx series

  clock-names:
    items:
      - const: alwayson
      - const: core
      - const: iface
      - const: mem
      - const: mem_iface
      - const: rbbmtimer

  interconnects:
    minItems: 1
    maxItems: 2

  interconnect-names:
    minItems: 1
    maxItems: 2

  interrupts:
    maxItems: 1
  
  iommus:
    items:
      - description: Phandle to gpu smmu

  power-domains:
    maxItems: 1

  operating-points-v2: true
  opp-table:
    type: object

  zap-shader:
    type: object
    additionalProperties: false
    description: |
      For a5xx and a6xx devices this node contains a memory-region that
      points to reserved memory to store the zap shader that can be used to
      help bring the GPU out of secure mode.
    properties:
      memory-region:
        maxItems: 1

      firmware-name:
        description: |
          Default name of the firmware to load to the remote processor.

  "#cooling-cells":
    const: 2

  nvmem-cell-names:
    maxItems: 1

  nvmem-cells:
    description: efuse registers
    maxItems: 1

required:
  - reg
  - reg-names
  - clocks
  - clock-names
  - interrupts
  - iommus
  - power-domains

unevaluatedProperties: false

examples:
  - |
    // Example a506 :

    #include <dt-bindings/clock/qcom,gcc-msm8953.h>
    #include <dt-bindings/power/qcom-rpmpd.h>
    #include <dt-bindings/interrupt-controller/irq.h>
    #include <dt-bindings/interrupt-controller/arm-gic.h>

    reserved-memory {
        #address-cells = <2>;
        #size-cells = <2>;

        zap_shader_region: memory@81800000 {
            compatible = "shared-dma-pool";
            reg = <0x0 0x81800000 0x0 0x2000>;
            no-map;
        };
    };


    gpu@1c00000 {
        compatible = "qcom,adreno-506.0", "qcom,adreno";

        reg = <0x01c00000 0x40000>;
        reg-names = "kgsl_3d0_reg_memory";

        interrupts = <GIC_SPI 33 IRQ_TYPE_LEVEL_HIGH>;

        clocks = <&gcc GCC_OXILI_AON_CLK>,
                 <&gcc GCC_OXILI_GFX3D_CLK>,
                 <&gcc GCC_OXILI_AHB_CLK>,
                 <&gcc GCC_BIMC_GFX_CLK>,
                 <&gcc GCC_BIMC_GPU_CLK>,
                 <&gcc GCC_OXILI_TIMER_CLK>;

        clock-names = "alwayson",
                      "core",
                      "iface",
                      "mem",
                      "mem_iface",
                      "rbbmtimer";

        power-domains = <&gcc OXILI_GX_GDSC>;
        iommus = <&gpu_iommu 0>;

        nvmem-cells = <&speedbin_efuse>;
        nvmem-cell-names = "speed_bin";

        operating-points-v2 = <&gpu_opp_table>;

        #cooling-cells = <2>;

        gpu_opp_table: opp-table {
            compatible = "operating-points-v2";

            opp-200000000 {
                opp-hz = /bits/ 64 <200000000>;
                opp-supported-hw = <0x1ff>;
            };

            opp-266670000 {
                opp-hz = /bits/ 64 <266670000>;
                opp-supported-hw = <0x1ff>;
            };

            opp-320000000 {
                opp-hz = /bits/ 64 <320000000>;
                opp-supported-hw = <0x1ff>;
            };

            opp-400000000  {
                opp-hz = /bits/ 64 <400000000>;
                opp-supported-hw = <0x1ff>;
            };

            opp-510000000 {
                opp-hz = /bits/ 64 <510000000>;
                opp-supported-hw = <0x1ff>;
            };

            opp-560000000 {
                opp-hz = /bits/ 64 <560000000>;
                opp-supported-hw = <0x1ff>;
            };

            opp-600000000 {
                opp-hz = /bits/ 64 <600000000>;
                opp-supported-hw = <0x1ff>;
            };

            opp-650000000 {
                opp-hz = /bits/ 64 <650000000>;
                opp-supported-hw = <0x185>;
            };

            opp-685000000 {
                opp-hz = /bits/ 64 <685000000>;
                opp-supported-hw = <0x100>;
            };

            opp-725000000 {
                opp-hz = /bits/ 64 <725000000>;
                opp-supported-hw = <0x100>;
            };
        };

        zap-shader {
            memory-region = <&zap_shader_region>;
            firmware-name = "a506_zap.mdt";
        };
    };
```

## Documentation/devicetree/bindings/display/msm/qcom,adreno-530.yaml
```yaml
# SPDX-License-Identifier: GPL-2.0-only OR BSD-2-Clause
%YAML 1.2
---
$id: http://devicetree.org/schemas/display/msm/qcom,adreno-530.yaml#
$schema: http://devicetree.org/meta-schemas/core.yaml#

title: Qualcomm Adreno 530 GPU

maintainers:
  - Rob Clark <robdclark@gmail.com>

description:
  Qualcomm Adreno 530 GPU

select:
  properties:
    compatible:
      contains:
        enum:
          - qcom,adreno-530.2
  required:
    - compatible

properties:
  $nodename:
    pattern: "^gpu@[0-9a-f]+$"

  compatible:
    items:
      - enum:
          - qcom,adreno-530.2
      - const: qcom,adreno

  reg:
    items:
      - description: base address of GPU device

  reg-names:
    items:
      - const: kgsl_3d0_reg_memory

  clocks:
    items:
      - description: GPU Core clock
      - description: GPU Interface clock
      - description: GPU RBBM Timer for Adreno 5xx series
      - description: GPU Memory clock
      - description: GPU Memory Interface clock

  clock-names:
    items:
      - const: core
      - const: iface
      - const: rbbmtimer
      - const: mem
      - const: mem_iface

  interconnects:
    minItems: 1
    maxItems: 2

  interconnect-names:
    minItems: 1
    maxItems: 2

  interrupts:
    maxItems: 1
  
  iommus:
    items:
      - description: Phandle to gpu smmu

  power-domains:
    items:
      - description: GPU GX power domain

  operating-points-v2: true
  opp-table:
    type: object

  zap-shader:
    type: object
    additionalProperties: false
    description: |
      For a5xx and a6xx devices this node contains a memory-region that
      points to reserved memory to store the zap shader that can be used to
      help bring the GPU out of secure mode.
    properties:
      memory-region:
        maxItems: 1

      firmware-name:
        description: |
          Default name of the firmware to load to the remote processor.

  "#cooling-cells":
    const: 2

  nvmem-cell-names:
    maxItems: 1

  nvmem-cells:
    description: efuse registers
    maxItems: 1

required:
  - reg
  - reg-names
  - clocks
  - clock-names
  - interrupts
  - iommus
  - power-domains

unevaluatedProperties: false

examples:
  - |
    // Example a530 :

    #include <dt-bindings/clock/qcom,gcc-msm8996.h>
    #include <dt-bindings/clock/qcom,mmcc-msm8996.h>
    #include <dt-bindings/power/qcom-rpmpd.h>
    #include <dt-bindings/interrupt-controller/irq.h>
    #include <dt-bindings/interrupt-controller/arm-gic.h>
    #include <dt-bindings/interconnect/qcom,msm8996.h>

    reserved-memory {
        #address-cells = <2>;
        #size-cells = <2>;

        gpu_mem: memory@90f00000 {
            compatible = "shared-dma-pool";
            reg = <0x0 0x90f00000 0x0 0x100000>;
            no-map;
        };
    };

    gpu@b00000 {
        compatible = "qcom,adreno-530.2", "qcom,adreno";

        reg = <0x00b00000 0x3f000>;
        reg-names = "kgsl_3d0_reg_memory";

        interrupts = <GIC_SPI 300 IRQ_TYPE_LEVEL_HIGH>;

        clocks = <&mmcc GPU_GX_GFX3D_CLK>,
                 <&mmcc GPU_AHB_CLK>,
                 <&mmcc GPU_GX_RBBMTIMER_CLK>,
                 <&gcc GCC_BIMC_GFX_CLK>,
                 <&gcc GCC_MMSS_BIMC_GFX_CLK>;

        clock-names = "core",
                      "iface",
                      "rbbmtimer",
                      "mem",
                      "mem_iface";

        power-domains = <&mmcc GPU_GX_GDSC>;
        iommus = <&adreno_smmu 0>;

        nvmem-cells = <&speedbin_efuse>;
        nvmem-cell-names = "speed_bin";

        operating-points-v2 = <&gpu_opp_table>;

        interconnects = <&bimc MASTER_GRAPHICS_3D &bimc SLAVE_EBI_CH0>;
        interconnect-names = "gfx-mem";

        #cooling-cells = <2>;

        gpu_opp_table: opp-table {
            compatible = "operating-points-v2";

            opp-624000000 {
                opp-hz = /bits/ 64 <624000000>;
                opp-supported-hw = <0x09>;
            };

           opp-560000000 {
                opp-hz = /bits/ 64 <560000000>;
                opp-supported-hw = <0x0d>;
            };

            opp-510000000 {
                opp-hz = /bits/ 64 <510000000>;
                opp-supported-hw = <0xff>;
            };

            opp-401800000 {
                opp-hz = /bits/ 64 <401800000>;
                opp-supported-hw = <0xff>;
            };

            opp-315000000 {
                opp-hz = /bits/ 64 <315000000>;
                opp-supported-hw = <0xff>;
            };

            opp-214000000 {
                opp-hz = /bits/ 64 <214000000>;
                opp-supported-hw = <0xff>;
            };

            opp-133000000 {
                opp-hz = /bits/ 64 <133000000>;
                opp-supported-hw = <0xff>;
            };
        };

        zap-shader {
            memory-region = <&gpu_mem>;
        };
    };
```

## Documentation/devicetree/bindings/display/msm/qcom,adreno-540.yaml
```yaml
# SPDX-License-Identifier: GPL-2.0-only OR BSD-2-Clause
%YAML 1.2
---
$id: http://devicetree.org/schemas/display/msm/qcom,adreno-540.yaml#
$schema: http://devicetree.org/meta-schemas/core.yaml#

title: Qualcomm Adreno 5xx GPU

maintainers:
  - Rob Clark <robdclark@gmail.com>

description:
  Device tree bindings for Adreno 540 GPU.

select:
  properties:
    compatible:
      contains:
        enum:
          - qcom,adreno-508.0
          - qcom,adreno-512.0
          - qcom,adreno-540.1
  required:
    - compatible

properties:
  $nodename:
    pattern: "^gpu@[0-9a-f]+$"

  compatible:
    items:
      - enum:
          - qcom,adreno-508.0
          - qcom,adreno-512.0
          - qcom,adreno-540.1
      - const: qcom,adreno

  reg:
    items:
      - description: base address of GPU device

  reg-names:
    items:
      - const: kgsl_3d0_reg_memory

  clocks:
    items:
      - description: GPU Interface clock
      - description: GPU RBBM Timer for Adreno 5xx series
      - description: GPU Memory clock
      - description: GPU Memory Interface clock
      - description: GPU RBCPR clock
      - description: GPU Core clock

  clock-names:
    items:
      - const: iface
      - const: rbbmtimer
      - const: mem
      - const: mem_iface
      - const: rbcpr
      - const: core

  interconnects:
    minItems: 1
    maxItems: 2

  interconnect-names:
    minItems: 1
    maxItems: 2

  interrupts:
    maxItems: 1
  
  iommus:
    items:
      - description: Phandle to gpu smmu

  power-domains:
    maxItems: 1

  operating-points-v2: true
  opp-table:
    type: object

  zap-shader:
    type: object
    additionalProperties: false
    description: |
      For a5xx and a6xx devices this node contains a memory-region that
      points to reserved memory to store the zap shader that can be used to
      help bring the GPU out of secure mode.
    properties:
      memory-region:
        maxItems: 1

      firmware-name:
        description: |
          Default name of the firmware to load to the remote processor.

  "#cooling-cells":
    const: 2

  nvmem-cell-names:
    maxItems: 1

  nvmem-cells:
    description: efuse registers
    maxItems: 1

required:
  - reg
  - reg-names
  - clocks
  - clock-names
  - interrupts
  - iommus
  - power-domains

unevaluatedProperties: false

examples:
  - |
    // Example a540 :

    #include <dt-bindings/clock/qcom,gcc-msm8998.h>
    #include <dt-bindings/clock/qcom,gpucc-msm8998.h>
    #include <dt-bindings/power/qcom-rpmpd.h>
    #include <dt-bindings/interrupt-controller/irq.h>
    #include <dt-bindings/interrupt-controller/arm-gic.h>

    gpu@5000000 {
        compatible = "qcom,adreno-540.1", "qcom,adreno";

        reg = <0x05000000 0x40000>;
        reg-names = "kgsl_3d0_reg_memory";

        interrupts = <GIC_SPI 300 IRQ_TYPE_LEVEL_HIGH>;

        clocks = <&gcc GCC_GPU_CFG_AHB_CLK>,
                 <&gpucc RBBMTIMER_CLK>,
                 <&gcc GCC_BIMC_GFX_CLK>,
                 <&gcc GCC_GPU_BIMC_GFX_CLK>,
                 <&gpucc RBCPR_CLK>,
                 <&gpucc GFX3D_CLK>;

        clock-names = "iface",
                      "rbbmtimer",
                      "mem",
                      "mem_iface",
                      "rbcpr",
                      "core";

        power-domains = <&rpmpd MSM8998_VDDMX>;
        iommus = <&adreno_smmu 0>;

        operating-points-v2 = <&gpu_opp_table>;

        #cooling-cells = <2>;

        gpu_opp_table: opp-table {
            compatible = "operating-points-v2";

            opp-710000097 {
                opp-hz = /bits/ 64 <710000097>;
                opp-level = <RPM_SMD_LEVEL_TURBO>;
                opp-supported-hw = <0xff>;
            };

           opp-670000048 {
                opp-hz = /bits/ 64 <670000048>;
                opp-level = <RPM_SMD_LEVEL_NOM_PLUS>;
                opp-supported-hw = <0xff>;
            };

            opp-596000097 {
                opp-hz = /bits/ 64 <596000097>;
                opp-level = <RPM_SMD_LEVEL_NOM>;
                opp-supported-hw = <0xff>;
            };

            opp-515000097 {
                opp-hz = /bits/ 64 <515000097>;
                opp-level = <RPM_SMD_LEVEL_SVS_PLUS>;
                opp-supported-hw = <0xff>;
            };

            opp-414000000 {
                opp-hz = /bits/ 64 <414000000>;
                opp-level = <RPM_SMD_LEVEL_SVS>;
                opp-supported-hw = <0xff>;
            };

            opp-342000000 {
                opp-hz = /bits/ 64 <342000000>;
                opp-level = <RPM_SMD_LEVEL_LOW_SVS>;
                opp-supported-hw = <0xff>;
            };

            opp-257000000 {
                opp-hz = /bits/ 64 <257000000>;
                opp-level = <RPM_SMD_LEVEL_MIN_SVS>;
                opp-supported-hw = <0xff>;
            };
        };
    };
```
