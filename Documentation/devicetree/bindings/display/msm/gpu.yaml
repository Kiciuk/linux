## Documentation/devicetree/bindings/display/msm/qcom,adreno-6xx.yaml
```yaml
# SPDX-License-Identifier: GPL-2.0-only OR BSD-2-Clause
%YAML 1.2
---
$id: http://devicetree.org/schemas/display/msm/qcom,adreno-6xx.yaml#
$schema: http://devicetree.org/meta-schemas/core.yaml#

title: Qualcomm Adreno 6xx GPU

maintainers:
  - Rob Clark <robdclark@gmail.com>

description:
  Device tree bindings for Adreno 600 series of GPU.

properties:
  compatible:
    contains:
      enum:
        - qcom,adreno-610.0
        - qcom,adreno-619.1

allOf:
  - $ref: qcom,adreno-common.yaml#
  - if:
      properties:
        compatible:
          contains:
            enum:
              - qcom,adreno-610.0
              - qcom,adreno-619.1
    then:
      properties:
        clocks:
          minItems: 6
          maxItems: 6

        clock-names:
          items:
            - const: core
              description: GPU Core clock
            - const: iface
              description: GPU Interface clock
            - const: mem_iface
              description: GPU Memory Interface clock
            - const: alt_mem_iface
              description: GPU Alternative Memory Interface clock
            - const: gmu
              description: CX GMU clock
            - const: xo
              description: GPUCC clocksource clock

        reg-names:
          minItems: 1
          items:
            - const: kgsl_3d0_reg_memory
            - const: cx_dbgc

      required:
        - clocks
        - clock-names
    else:
      if:
        properties:
          compatible:
            contains:
              pattern: '^qcom,adreno-[67][0-9][0-9]\.[0-9]$'

      then: # Starting with A6xx, the clocks are usually defined in the GMU node
        properties:
          clocks: false
          clock-names: false

          reg-names:
            minItems: 1
            items:
              - const: kgsl_3d0_reg_memory
              - const: cx_mem
              - const: cx_dbgc

unevaluatedProperties: false

examples:
  - |
    // Example a6xx (with GMU):

    #include <dt-bindings/clock/qcom,gpucc-sdm845.h>
    #include <dt-bindings/clock/qcom,gcc-sdm845.h>
    #include <dt-bindings/power/qcom-rpmpd.h>
    #include <dt-bindings/interrupt-controller/irq.h>
    #include <dt-bindings/interrupt-controller/arm-gic.h>
    #include <dt-bindings/interconnect/qcom,sdm845.h>

    reserved-memory {
        #address-cells = <2>;
        #size-cells = <2>;

        zap_shader_region: memory@8f200000 {
            compatible = "shared-dma-pool";
            reg = <0x0 0x90b00000 0x0 0xa00000>;
            no-map;
        };
    };

    gpu@5000000 {
        compatible = "qcom,adreno-630.2", "qcom,adreno";

        reg = <0x5000000 0x40000>, <0x509e000 0x10>;
        reg-names = "kgsl_3d0_reg_memory", "cx_mem";

        #cooling-cells = <2>;

        interrupts = <GIC_SPI 300 IRQ_TYPE_LEVEL_HIGH>;

        iommus = <&adreno_smmu 0>;

        operating-points-v2 = <&gpu_opp_table>;

        interconnects = <&rsc_hlos MASTER_GFX3D &rsc_hlos SLAVE_EBI1>;
        interconnect-names = "gfx-mem";

        qcom,gmu = <&gmu>;

        gpu_opp_table: opp-table {
            compatible = "operating-points-v2";

            opp-430000000 {
                opp-hz = /bits/ 64 <430000000>;
                opp-level = <RPMH_REGULATOR_LEVEL_SVS_L1>;
                opp-peak-kBps = <5412000>;
            };

            opp-355000000 {
                opp-hz = /bits/ 64 <355000000>;
                opp-level = <RPMH_REGULATOR_LEVEL_SVS>;
                opp-peak-kBps = <3072000>;
            };

            opp-267000000 {
                opp-hz = /bits/ 64 <267000000>;
                opp-level = <RPMH_REGULATOR_LEVEL_LOW_SVS>;
                opp-peak-kBps = <3072000>;
            };

            opp-180000000 {
                opp-hz = /bits/ 64 <180000000>;
                opp-level = <RPMH_REGULATOR_LEVEL_MIN_SVS>;
                opp-peak-kBps = <1804000>;
            };
        };

        zap-shader {
            memory-region = <&zap_shader_region>;
            firmware-name = "qcom/LENOVO/81JL/qcdxkmsuc850.mbn";
        };
    };
...
```

## Documentation/devicetree/bindings/display/msm/qcom,adreno-common.yaml
```yaml
# SPDX-License-Identifier: GPL-2.0-only OR BSD-2-Clause
%YAML 1.2
---
$id: http://devicetree.org/schemas/display/msm/qcom,adreno-common.yaml#
$schema: http://devicetree.org/meta-schemas/core.yaml#

title: Qualcomm Adreno common properties

maintainers:
  - Rob Clark <robdclark@gmail.com>

description:
  Device tree bindings for Adreno GPUs

properties:
  $nodename:
    pattern: "^gpu@[0-9a-f]+$"

  reg:
    minItems: 1
    maxItems: 3

  reg-names:
    minItems: 1
    maxItems: 3

  power-domains:
    maxItems: 1

  clocks:
    minItems: 2
    maxItems: 6

  clock-names:
    minItems: 2
    maxItems: 6

  interrupts:
    maxItems: 1

  interrupt-names:
    maxItems: 1

  interconnects:
    minItems: 1
    maxItems: 2

  interconnect-names:
    minItems: 1
    maxItems: 2

  iommus:
    minItems: 1
    maxItems: 64

  sram:
    $ref: /schemas/types.yaml#/definitions/phandle-array
    minItems: 1
    maxItems: 4
    items:
      maxItems: 1
    description: |
      phandles to one or more reserved on-chip SRAM regions.
      phandle to the On Chip Memory (OCMEM) that's present on some a3xx and
      a4xx Snapdragon SoCs. See
      Documentation/devicetree/bindings/sram/qcom,ocmem.yaml

  operating-points-v2: true
  opp-table:
    type: object

  zap-shader:
    type: object
    additionalProperties: false
    description: |
      For a5xx and a6xx devices this node contains a memory-region that
      points to reserved memory to store the zap shader that can be used to
      help bring the GPU out of secure mode.
    properties:
      memory-region:
        maxItems: 1

      firmware-name:
        description: |
          Default name of the firmware to load to the remote processor.

  "#cooling-cells":
    const: 2

  nvmem-cell-names:
    maxItems: 1

  nvmem-cells:
    description: efuse registers
    maxItems: 1
    
  qcom,gmu:
    $ref: /schemas/types.yaml#/definitions/phandle
    description: |
      For GMU attached devices a phandle to the GMU device that will
      control the power for the GPU.

required:
  - reg
  - reg-names
  - power-domains
  - interrupts
  - iommus

additionalProperties: true
```

## Documentation/devicetree/bindings/display/msm/qcom,adreno-gen-x.yaml
```yaml
# SPDX-License-Identifier: GPL-2.0-only OR BSD-2-Clause
%YAML 1.2
---
$id: http://devicetree.org/schemas/display/msm/qcom,adreno-gen-x.yaml#
$schema: http://devicetree.org/meta-schemas/core.yaml#

title: Qualcomm Adreno Gen X GPU

maintainers:
  - Rob Clark <robdclark@gmail.com>

description:
  Qualcomm Adreno Gen X GPU

select:
  properties:
    compatible:
      contains:
        pattern: '^qcom,adreno-[0-9a-f][0-9a-f][0-9a-f][0-9a-f][0-9a-f][0-9a-f][0-9a-f][0-9a-f]$'
  required:
    - compatible

properties:
  $nodename:
    pattern: "^gpu@[0-9a-f]+$"

  compatible:
    items:
      - pattern: '^qcom,adreno-[0-9a-f][0-9a-f][0-9a-f][0-9a-f][0-9a-f][0-9a-f][0-9a-f][0-9a-f]$'
      - const: qcom,adreno

  reg:
    items:
      - description: base address of GPU device
      - description: CX memory region
      - description: CX debug region
      
  reg-names:
    items:
      - const: kgsl_3d0_reg_memory
      - const: cx_mem
      - const: cx_dbgc
  
  interrupts:
    maxItems: 1
  
  iommus:
    minItems: 1
    maxItems: 2

  operating-points-v2: true
  opp-table:
    type: object

  zap-shader:
    type: object
    additionalProperties: false
    description: |
      For a5xx and a6xx devices this node contains a memory-region that
      points to reserved memory to store the zap shader that can be used to
      help bring the GPU out of secure mode.
    properties:
      memory-region:
        maxItems: 1

      firmware-name:
        description: |
          Default name of the firmware to load to the remote processor.

  "#cooling-cells":
    const: 2

  nvmem-cell-names:
    maxItems: 1

  nvmem-cells:
    description: efuse registers
    maxItems: 1

  qcom,gmu:
    $ref: /schemas/types.yaml#/definitions/phandle
    description: |
      For GMU attached devices a phandle to the GMU device that will
      control the power for the GPU.

required:
  - reg
  - reg-names
  - interrupts
  - iommus

additionalProperties: true

examples:
  - |

    #include <dt-bindings/clock/qcom,rpmh.h>
    #include <dt-bindings/power/qcom-rpmpd.h>
    #include <dt-bindings/interrupt-controller/irq.h>
    #include <dt-bindings/interrupt-controller/arm-gic.h>


    reserved-memory {
        #address-cells = <2>;
        #size-cells = <2>;

        gpu_micro_code_mem: gpu-micro-code-region@9b09a000 {
            reg = <0 0x9b09a000 0 0x2000>;
            no-map;
        };
    };

    gpu@3d00000 {
        compatible = "qcom,adreno-43050a01", "qcom,adreno";

        reg = <0x03d00000 0x40000>,
              <0x03d9e000 0x1000>,
              <0x03d61000 0x800>;
        reg-names = "kgsl_3d0_reg_memory",
                    "cx_mem",
                    "cx_dbgc";

        interrupts = <GIC_SPI 300 IRQ_TYPE_LEVEL_HIGH>;

        iommus = <&adreno_smmu 0 0x0>,
                 <&adreno_smmu 1 0x0>;

        operating-points-v2 = <&gpu_opp_table>;

        qcom,gmu = <&gmu>;

        gpu_opp_table: opp-table {
            compatible = "operating-points-v2";

            opp-680000000 {
              opp-hz = /bits/ 64 <680000000>;
              opp-level = <RPMH_REGULATOR_LEVEL_SVS_L1>;
            };

            opp-615000000 {
              opp-hz = /bits/ 64 <615000000>;
              opp-level = <RPMH_REGULATOR_LEVEL_SVS_L0>;
            };

            opp-550000000 {
              opp-hz = /bits/ 64 <550000000>;
              opp-level = <RPMH_REGULATOR_LEVEL_SVS>;
            };

            opp-475000000 {
              opp-hz = /bits/ 64 <475000000>;
             opp-level = <RPMH_REGULATOR_LEVEL_LOW_SVS_L1>;
            };

            opp-401000000 {
              opp-hz = /bits/ 64 <401000000>;
              opp-level = <RPMH_REGULATOR_LEVEL_LOW_SVS>;
            };

            opp-348000000 {
              opp-hz = /bits/ 64 <348000000>;
              opp-level = <RPMH_REGULATOR_LEVEL_LOW_SVS_D0>;
            };

            opp-295000000 {
              opp-hz = /bits/ 64 <295000000>;
              opp-level = <RPMH_REGULATOR_LEVEL_LOW_SVS_D1>;
            };

            opp-220000000 {
              opp-hz = /bits/ 64 <220000000>;
              opp-level = <RPMH_REGULATOR_LEVEL_LOW_SVS_D2>;
            };
          };

            zap-shader {
                memory-region = <&gpu_micro_code_mem>;
            };
        };
```

## Documentation/devicetree/bindings/interconnect/qcom,msm8937.yaml
```yaml
# SPDX-License-Identifier: (GPL-2.0 OR BSD-2-Clause)
%YAML 1.2
---
$id: http://devicetree.org/schemas/interconnect/qcom,msm8937.yaml#
$schema: http://devicetree.org/meta-schemas/core.yaml#

title: Qualcomm MSM8937 Network-On-Chip interconnect

maintainers:
  - Konrad Dybcio <konradybcio@kernel.org>

description: |
  The Qualcomm MSM8937 interconnect providers support adjusting the
  bandwidth requirements between the various NoC fabrics.

  See also:
  - dt-bindings/interconnect/qcom,msm8937.h

properties:
  compatible:
    enum:
      - qcom,msm8937-bimc
      - qcom,msm8937-pcnoc
      - qcom,msm8937-snoc

  reg:
    maxItems: 1

  '#interconnect-cells':
    const: 2

patternProperties:
  '^interconnect-[a-z0-9\-]+$':
    type: object
    $ref: qcom,rpm-common.yaml#
    unevaluatedProperties: false
    description:
      The interconnect providers do not have a separate QoS register space,
      but share parent's space.

    properties:
      compatible:
        const: qcom,msm8937-snoc-mm

    required:
      - compatible
      - '#interconnect-cells'

required:
  - compatible
  - reg
  - '#interconnect-cells'

additionalProperties: false

examples:
  - |
      bimc: interconnect@400000 {
          compatible = "qcom,msm8937-bimc";
          reg = <0x00400000 0x5a000>;

          #interconnect-cells = <2>;
      };
```

## Documentation/devicetree/bindings/interconnect/qcom,msm8976.yaml
```yaml
# SPDX-License-Identifier: (GPL-2.0 OR BSD-2-Clause)
%YAML 1.2
---
$id: http://devicetree.org/schemas/interconnect/qcom,msm8976.yaml#
$schema: http://devicetree.org/meta-schemas/core.yaml#

title: Qualcomm MSM8976 Network-On-Chip interconnect

maintainers:
  - Konrad Dybcio <konradybcio@kernel.org>

description: |
  The Qualcomm MSM8976 interconnect providers support adjusting the
  bandwidth requirements between the various NoC fabrics.

  See also:
  - dt-bindings/interconnect/qcom,msm8976.h

properties:
  compatible:
    enum:
      - qcom,msm8976-bimc
      - qcom,msm8976-pcnoc
      - qcom,msm8976-snoc

  reg:
    maxItems: 1

  '#interconnect-cells':
    const: 2

patternProperties:
  '^interconnect-[a-z0-9\-]+$':
    type: object
    $ref: qcom,rpm-common.yaml#
    unevaluatedProperties: false
    description:
      The interconnect providers do not have a separate QoS register space,
      but share parent's space.

    properties:
      compatible:
        const: qcom,msm8976-snoc-mm

    required:
      - compatible
      - '#interconnect-cells'

required:
  - compatible
  - reg
  - '#interconnect-cells'

additionalProperties: false

examples:
  - |
      bimc: interconnect@400000 {
          compatible = "qcom,msm8976-bimc";
          reg = <0x00400000 0x62000>;

          #interconnect-cells = <2>;
      };
```

## drivers/power/Kconfig
```kconfig
# SPDX-License-Identifier: GPL-2.0-only
source "drivers/power/avs/Kconfig"
source "drivers/power/reset/Kconfig"
source "drivers/power/supply/Kconfig"

config PD_PROXY
	tristate "Power domain proxy driver"
	depends on OF
	help
        Power domain helper driver which can proxy/aggregate power-domains.
```
